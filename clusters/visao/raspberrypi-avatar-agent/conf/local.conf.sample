## clusters/visao/raspberrypi-avatar-agent/conf/local.conf.sample
```bitbake
MACHINE ??= "raspberrypi4-64"
DISTRO ?= "poky"
PACKAGE_CLASSES ?= "package_rpm"
EXTRA_IMAGE_FEATURES ?= "debug-tweaks ssh-server-openssh"

INIT_MANAGER = "systemd"
VIRTUAL-RUNTIME_init_manager = "systemd"
VIRTUAL-RUNTIME_initscripts = ""

ENABLE_UART = "1"
GPU_MEM = "128"
IMAGE_ROOTFS_EXTRA_SPACE = "524288"
DISTRO_FEATURES:append = " alsa opengl systemd usrmerge"
BB_NO_NETWORK ?= "0"
```

## yocto/raspberrypi-avatar-agent/meta-casa-avatar/conf/layer.conf
```bitbake
BBPATH .= ":${LAYERDIR}"
BBFILES += "${LAYERDIR}/recipes-*/*/*.bb ${LAYERDIR}/recipes-*/*/*.bbappend"

BBFILE_COLLECTIONS += "casa-avatar"
BBFILE_PATTERN_casa-avatar = "^${LAYERDIR}/"
BBFILE_PRIORITY_casa-avatar = "8"

LAYERDEPENDS_casa-avatar = "core openembedded-layer meta-python raspberrypi"
LAYERSERIES_COMPAT_casa-avatar = "scarthgap"
```
